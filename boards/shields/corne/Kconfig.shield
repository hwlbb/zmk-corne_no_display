## boards/shields/corne/Kconfig.shield
```kconfig
# Copyright (c) 2020 Pete Johanson
# SPDX-License-Identifier: MIT

config SHIELD_CORNE_LEFT
    def_bool $(shields_list_contains,corne_left)

config SHIELD_CORNE_RIGHT
    def_bool $(shields_list_contains,corne_right)

if SHIELD_CORNE_LEFT || SHIELD_CORNE_RIGHT

config ZMK_KEYBOARD_NAME
    default "Corne"

config ZMK_SPLIT
    default y

endif

if SHIELD_CORNE_LEFT

config ZMK_SPLIT_ROLE_CENTRAL
    default y

endif

if SHIELD_CORNE_LEFT || SHIELD_CORNE_RIGHT

config ZMK_SPLIT_BLE
    default y

endif
```
